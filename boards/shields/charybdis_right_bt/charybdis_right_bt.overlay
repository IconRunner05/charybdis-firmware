/* Per-side breakout map MUST come before charybdis.dtsi so the shared
 * dtsi sees MATRIX_ROW*_GPIO for this half. */
#include "../charybdis_common/breakout_right.dtsi"
#include "../charybdis_common/charybdis.dtsi"
#include "../charybdis_trackball/charybdis_pmw3610.dtsi"
#include "../../config/trackball/charybdis_pointer.dtsi"

// The matrix transform is 6 columns over because the left half is 6 columns wide.
&default_transform {
	col-offset = <6>;
};

&five_column_transform {
	col-offset = <5>;
};

&kscan0 {
	/* Col pins reference pad macros from breakout_right.dtsi. */
	col-gpios
		= <R_PAD_C1 (GPIO_ACTIVE_HIGH | GPIO_PULL_DOWN)>
		, <R_PAD_C2 (GPIO_ACTIVE_HIGH | GPIO_PULL_DOWN)>
		, <R_PAD_C3 (GPIO_ACTIVE_HIGH | GPIO_PULL_DOWN)>
		, <R_PAD_C4 (GPIO_ACTIVE_HIGH | GPIO_PULL_DOWN)>
		, <R_PAD_C5 (GPIO_ACTIVE_HIGH | GPIO_PULL_DOWN)>
		, <R_PAD_C6 (GPIO_ACTIVE_HIGH | GPIO_PULL_DOWN)>
		;
};

/* enable the listener on central */
&trackball_listener {
    status = "okay";
    device = <&trackball>;
};
