/* Per-side breakout map MUST come before charybdis.dtsi so the shared
 * dtsi sees MATRIX_ROW*_GPIO for this half. */
#include "../charybdis_common/breakout_left.dtsi"
#include "../charybdis_common/charybdis.dtsi"

&kscan0 {
	/* Col pins reference pad macros from breakout_left.dtsi. */
	col-gpios
		= <L_PAD_C1 (GPIO_ACTIVE_HIGH | GPIO_PULL_DOWN)>
		, <L_PAD_C2 (GPIO_ACTIVE_HIGH | GPIO_PULL_DOWN)>
		, <L_PAD_C3 (GPIO_ACTIVE_HIGH | GPIO_PULL_DOWN)>
		, <L_PAD_C4 (GPIO_ACTIVE_HIGH | GPIO_PULL_DOWN)>
		, <L_PAD_C5 (GPIO_ACTIVE_HIGH | GPIO_PULL_DOWN)>
		, <L_PAD_C6 (GPIO_ACTIVE_HIGH | GPIO_PULL_DOWN)>
		;
};
